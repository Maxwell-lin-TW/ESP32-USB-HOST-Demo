## main/Kconfig.projbuild
```kconfig
menu "Example of USB Host Application"

    config EXAMPLE_ENABLE_USB_HID
        bool "ENABLE_USB_HID"
        default y
        help
            Enable USB Host HID application

    config EXAMPLE_ENABLE_USB_MSC
        bool "ENABLE_USB_MSC"
        default y
        help
            Enable USB Host MSC application

    config EXAMPLE_ENABLE_USB_CDC_ACM
        bool "ENABLE_USB_CDC_ACM"
        default y
        help
            Enable USB Host CDC ACM application

    config EXAMPLE_ENABLE_USB_CDC_ECM
        bool "ENABLE_USB_CDC_ECM"
        default y
        help
            Enable USB Host CDC ECM application

endmenu
```
